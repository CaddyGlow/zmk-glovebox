## <bound method DockerPath.host of DockerPath(host_path=PosixPath('/tmp/zmk_configwd6l6ba8'), container_path='/workspace')>/config/west.yml
```yaml
# West configuration for ZMK - Generated by Glovebox
manifest:
  remotes:
  - name: moergo-sc
    url-base: https://github.com/moergo-sc
  projects:
  - name: zmk
    remote: moergo-sc
    revision: v25.05
    import: app/west.yml
  self:
    path: config
```
